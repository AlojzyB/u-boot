## board/digi/ccimx8x_sbc_express/Kconfig
```kconfig
if TARGET_CCIMX8X_SBC_EXPRESS

source "board/digi/common/Kconfig"

config SYS_BOARD
	default "ccimx8x_sbc_express"

config SYS_VENDOR
	default "digi"

config SYS_CONFIG_NAME
	default "ccimx8x_sbc_express"

config IMX_CONFIG
	default "board/digi/ccimx8x/imximage.cfg"

endif
```
